## base_external/Config.in
```kconfig
source "$BR2_EXTERNAL_project_base_PATH/package/gpio/Config.in"
source "$BR2_EXTERNAL_project_base_PATH/package/solarcell/Config.in"
source "$BR2_EXTERNAL_project_base_PATH/package/sockettest/Config.in"
source "$BR2_EXTERNAL_project_base_PATH/package/Scanner/Config.in"
```

## base_external/package/Scanner/Config.in
```kconfig
config BR2_PACKAGE_SCANNER
	bool "Scanner"
	help
	  Includes the writer executables, for the final 2d scanner functionality in the kernel image.
	  Used to understand buildroot external trees and package builds.
```

## base_external/package/gpio/Config.in
```kconfig
config BR2_PACKAGE_GPIO
	bool "gpio"
	help
	  Includes the writer executables, for gpio functionality verification in the kernel image.
	  Used to understand buildroot external trees and package builds.
```

## base_external/package/sockettest/Config.in
```kconfig
config BR2_PACKAGE_SOCKETTEST
	bool "sockettest"
	help
	  Includes the writer executables, for socket test
```

## base_external/package/solarcell/Config.in
```kconfig
config BR2_PACKAGE_SOLARCELL
	bool "solarcell"
	help
	  Includes the writer executables, for solarcell functionality
```
